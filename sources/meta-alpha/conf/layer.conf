## sources/meta-alpha/conf/layer.conf
```bitbake
BBPATH =. "${LAYERDIR}:"

BBFILE_COLLECTIONS += "alpha"
BBFILE_PATTERN_alpha := "^${LAYERDIR}"
BBFILE_PRIORITY_alpha = "10"

BBFILES += " \
        ${LAYERDIR}/recipes-*/*/*.bb \
        ${LAYERDIR}/recipes-*/*/*.bbappend \
        ${LAYERDIR}/classes/*.bb* \
"

# Set LAYERSERIES_COMPAT variable for meta-alb-bsp layer
# to match the version "kirkstone" of OpenEmbedded-Core
LAYERSERIES_COMPAT_alpha = "kirkstone"
```
